## conf/layer.conf
```bitbake
# We have a conf and classes directory, add to BBPATH
BBPATH .= ":${LAYERDIR}"

# We have recipes-* directories, add to BBFILES
BBFILES += "${LAYERDIR}/recipes-*/*/*.bb \
            ${LAYERDIR}/recipes-*/*/*.bbappend"

BBFILE_COLLECTIONS += "meta-st-stm32mpu-app-logicanalyser"
BBFILE_PATTERN_meta-st-stm32mpu-app-logicanalyser = "^${LAYERDIR}/"
BBFILE_PRIORITY_meta-st-stm32mpu-app-logicanalyser = "7"

STM32MPU_LOGICANALYSER_BASE = "${LAYERDIR}"

LAYERDEPENDS_meta-st-stm32mpu-app-logicanalyser = "core"
LAYERSERIES_COMPAT_meta-st-stm32mpu-app-logicanalyser = "mickledore"
```

## conf/machine/include/stm32mp1-demo-logicanalyser-config.inc
```bitbake
# Boot Mode Choice
# =========================================================================
# boot scheme
# =========================================================================
#BOOTSCHEME_LABELS ?= "basic"
BOOTSCHEME_LABELS ?= "trusted"
#BOOTSCHEME_LABELS ?= "optee"

# Boot Device Choice
# =========================================================================
# flashlayout
# =========================================================================
# Define the config labels to use to generate flashlayout file
FLASHLAYOUT_CONFIG_LABELS ?= "sdcard"

# Configs below only available with EVAL board
#FLASHLAYOUT_CONFIG_LABELS ?= "emmc"
#FLASHLAYOUT_CONFIG_LABELS ?= "nand-4-256"
#FLASHLAYOUT_CONFIG_LABELS ?= "nor-sdcard"
#FLASHLAYOUT_CONFIG_LABELS ?= "nor-emmc"
#FLASHLAYOUT_CONFIG_LABELS ?= "nor-nand-4-256"

# Board Type Choice
# =========================================================================
# Assign CubeMX Board DT and project name
CUBEMX_DTB ?= "stm32mp157c-demo-logic-analyser-mx"
CUBEMX_PROJECT ?= "STM32MP157C-DK2/demo-logic-analyser/DeviceTree/demo-logic-analyser"

# Define the original board devicetree
#CUBEMX_DT_FILE_BASE ?= "stm32mp157a-dk1"
#CUBEMX_DT_FILE_BASE ?= "stm32mp157c-dk2"
CUBEMX_DT_FILE_BASE ?= "stm32mp157c-dk2"
```

## conf/machine/include/stm32mp1-demo-logicanalyser-extlinux-config.inc
```bitbake
# =========================================================================
# EXTLINUX is dynamic according to FLASHLAYOUT CONFIG set
# =========================================================================
# Configure only original CubeMX machine for sdcard in order to add specific
# CubeMX label(s) to this default configuration
UBOOT_EXTLINUX_DEVICEFLAG_sdcard = "${CUBEMX_DT_FILE_BASE}"

# Configs below only available with EVAL board
UBOOT_EXTLINUX_DEVICEFLAG_emmc = "${CUBEMX_DT_FILE_BASE}"
UBOOT_EXTLINUX_DEVICEFLAG_nand-4-256 = "${CUBEMX_DT_FILE_BASE}"
UBOOT_EXTLINUX_DEVICEFLAG_nor-sdcard = "${CUBEMX_DT_FILE_BASE}"
UBOOT_EXTLINUX_DEVICEFLAG_nor-emmc = "${CUBEMX_DT_FILE_BASE}"
UBOOT_EXTLINUX_DEVICEFLAG_nor-nand-4-256 = "${CUBEMX_DT_FILE_BASE}"


############################################################################################
# Define overrides for CUBEMX labels
UBOOT_EXTLINUX_FDT_cubemx-sdcard = "/${CUBEMX_DTB}.dtb"
UBOOT_EXTLINUX_ROOT_cubemx-sdcard = "${EXTLINUX_ROOT_SDCARD}"

# Configs below only available with EVAL board
UBOOT_EXTLINUX_FDT_cubemx-emmc = "/${CUBEMX_DTB}.dtb"
UBOOT_EXTLINUX_ROOT_cubemx-emmc = "${EXTLINUX_ROOT_EMMC}"

UBOOT_EXTLINUX_FDT_cubemx-nand-4-256 = "/${CUBEMX_DTB}.dtb"
UBOOT_EXTLINUX_ROOT_cubemx-nand-4-256 = "${EXTLINUX_ROOT_NAND}"

UBOOT_EXTLINUX_FDT_cubemx-nor-sdcard = "/${CUBEMX_DTB}.dtb"
UBOOT_EXTLINUX_ROOT_cubemx-nor-sdcard = "${EXTLINUX_ROOT_NORSDCARD}"

UBOOT_EXTLINUX_FDT_cubemx-nor-emmc = "/${CUBEMX_DTB}.dtb"
UBOOT_EXTLINUX_ROOT_cubemx-nor-emmc = "${EXTLINUX_ROOT_NOREMMC}"

UBOOT_EXTLINUX_FDT_cubemx-nor-nand-4-256 = "/${CUBEMX_DTB}.dtb"
UBOOT_EXTLINUX_ROOT_cubemx-nor-nand-4-256 = "${EXTLINUX_ROOT_NAND}"


############################################################################################
#EVAL BOARD
# Append CUBEMX label to the original configured target (if cubemx devicetree exists)
UBOOT_EXTLINUX_LABELS_mp157c-ev1_sdcard += "${@'cubemx-sdcard' if os.path.isfile('${CUBEMX_DTB_PATH_pn-u-boot-stm32mp}/${CUBEMX_DTB}.dts') else ''}"
UBOOT_EXTLINUX_LABELS_mp157c-ev1_emmc += "${@'cubemx-emmc' if os.path.isfile('${CUBEMX_DTB_PATH_pn-u-boot-stm32mp}/${CUBEMX_DTB}.dts') else ''}"
UBOOT_EXTLINUX_LABELS_mp157c-ev1_nand-4-256 += "${@'cubemx-nand-4-256' if os.path.isfile('${CUBEMX_DTB_PATH_pn-u-boot-stm32mp}/${CUBEMX_DTB}.dts') else ''}"
UBOOT_EXTLINUX_LABELS_mp157c-ev1_nor-sdcard += "${@'cubemx-nor-sdcard' if os.path.isfile('${CUBEMX_DTB_PATH_pn-u-boot-stm32mp}/${CUBEMX_DTB}.dts') else ''}"
UBOOT_EXTLINUX_LABELS_mp157c-ev1_nor-emmc += "${@'cubemx-nor-emmc' if os.path.isfile('${CUBEMX_DTB_PATH_pn-u-boot-stm32mp}/${CUBEMX_DTB}.dts') else ''}"
UBOOT_EXTLINUX_LABELS_mp157c-ev1_nor-nand-4-256 += "${@'cubemx-nor-nand-4-256' if os.path.isfile('${CUBEMX_DTB_PATH_pn-u-boot-stm32mp}/${CUBEMX_DTB}.dts') else ''}"

# Set default boot config to CUBEMX label (if cubemx devicetree exists)
UBOOT_EXTLINUX_DEFAULT_LABEL_mp157c-ev1_sdcard = "${@'cubemx-sdcard' if os.path.isfile('${CUBEMX_DTB_PATH_pn-u-boot-stm32mp}/${CUBEMX_DTB}.dts') else '${CUBEMX_DT_FILE_BASE}-sdcard'}"
UBOOT_EXTLINUX_DEFAULT_LABEL_mp157c-ev1_emmc = "${@'cubemx-emmc' if os.path.isfile('${CUBEMX_DTB_PATH_pn-u-boot-stm32mp}/${CUBEMX_DTB}.dts') else '${CUBEMX_DT_FILE_BASE}-emmc'}"
UBOOT_EXTLINUX_DEFAULT_LABEL_mp157c-ev1_nand-4-256 = "${@'cubemx-nand-4-256' if os.path.isfile('${CUBEMX_DTB_PATH_pn-u-boot-stm32mp}/${CUBEMX_DTB}.dts') else '${CUBEMX_DT_FILE_BASE}-nand-4-256'}"
UBOOT_EXTLINUX_DEFAULT_LABEL_mp157c-ev1_nor-sdcard = "${@'cubemx-nor-sdcard' if os.path.isfile('${CUBEMX_DTB_PATH_pn-u-boot-stm32mp}/${CUBEMX_DTB}.dts') else '${CUBEMX_DT_FILE_BASE}-nor-sdcard'}"
UBOOT_EXTLINUX_DEFAULT_LABEL_mp157c-ev1_nor-emmc = "${@'cubemx-nor-emmc' if os.path.isfile('${CUBEMX_DTB_PATH_pn-u-boot-stm32mp}/${CUBEMX_DTB}.dts') else '${CUBEMX_DT_FILE_BASE}-nor-emmc'}"
UBOOT_EXTLINUX_DEFAULT_LABEL_mp157c-ev1_nor-nand-4-256 = "${@'cubemx-nor-nand-4-256' if os.path.isfile('${CUBEMX_DTB_PATH_pn-u-boot-stm32mp}/${CUBEMX_DTB}.dts') else '${CUBEMX_DT_FILE_BASE}-nor-nand-4-256'}"


############################################################################################
#DK2 BOARD
UBOOT_EXTLINUX_LABELS_mp157c-dk2_sdcard += "${@'cubemx-sdcard' if os.path.isfile('${CUBEMX_DTB_PATH_pn-u-boot-stm32mp}/${CUBEMX_DTB}.dts') else ''}"

UBOOT_EXTLINUX_DEFAULT_LABEL_mp157c-dk2_sdcard = "${@'cubemx-sdcard' if os.path.isfile('${CUBEMX_DTB_PATH_pn-u-boot-stm32mp}/${CUBEMX_DTB}.dts') else '${CUBEMX_DT_FILE_BASE}-sdcard'}"


############################################################################################
#DK1 BOARD
UBOOT_EXTLINUX_LABELS_mp157a-dk1_sdcard += "${@'cubemx-sdcard' if os.path.isfile('${CUBEMX_DTB_PATH_pn-u-boot-stm32mp}/${CUBEMX_DTB}.dts') else ''}"

UBOOT_EXTLINUX_DEFAULT_LABEL_mp157a-dk1_sdcard = "${@'cubemx-sdcard' if os.path.isfile('${CUBEMX_DTB_PATH_pn-u-boot-stm32mp}/${CUBEMX_DTB}.dts') else '${CUBEMX_DT_FILE_BASE}-sdcard'}"
```

## conf/machine/stm32mp1-demo-logicanalyser.conf
```bitbake
#@TYPE: Machine
#@NAME: stm32mp1-app-logicanalyser
#@DESCRIPTION: Configuration for STM32CubeMX generated project
#@NEEDED_BSPLAYERS: layers/meta-openembedded/meta-oe layers/meta-openembedded/meta-python layers/meta-st/meta-st-stm32mp-addons

###########################################################################
#
# Default machine configuration sections
#
###########################################################################

include conf/machine/include/st-machine-common-stm32mp.inc
include conf/machine/include/st-machine-providers-stm32mp.inc

# Define specific common machine name
MACHINEOVERRIDES .= ":stm32mpcommonlogicanalyser"

# =========================================================================
# Chip architecture
# =========================================================================
DEFAULTTUNE = "cortexa7thf-neon-vfpv4"
include conf/machine/include/tune-cortexa7.inc

# =========================================================================
# Machine settings
# =========================================================================
STM32MP_DEVICETREE = "${CUBEMX_DTB}"

# =========================================================================
# Machine features (default for stm32mp1 like)
# =========================================================================
MACHINE_FEATURES += "splashscreen"
MACHINE_FEATURES += "${@'gpu' if d.getVar('ACCEPT_EULA_'+d.getVar('MACHINE')) == '1' else ''}"
MACHINE_FEATURES += "m4copro"

# =========================================================================
# Device Storage
# =========================================================================
# Enable the board device storage support with CUBEMX_DTB according to BOOTDEVICE_LABELS
DEVICE_BOARD_ENABLE_SDCARD  += "${@bb.utils.contains('BOOTDEVICE_LABELS', 'sdcard', '${CUBEMX_DTB}', '', d)}"

# =========================================================================
# Flashlayout
# =========================================================================
# Set the FLASHLAYOUT_TYPE_LABELS to CUBEMX_DTB according to BOOTDEVICE_LABELS
FLASHLAYOUT_TYPE_LABELS_sdcard      = "${@bb.utils.contains('BOOTDEVICE_LABELS', 'sdcard', '${CUBEMX_DTB}', '', d)}"

# Specific settings for 'extensible' and 'deleteall' configurations
FLASHLAYOUT_CONFIG_LABELS_deleteall = "cubemx"
FLASHLAYOUT_TYPE_LABELS_deleteall_cubemx = "${CUBEMX_DTB}"
FLASHLAYOUT_TYPE_LABELS_extensible = "${CUBEMX_DTB}"

# =========================================================================
# CubeMX extra config
# =========================================================================
# Set specific subdir path by components for each device tree file location
# within CUBEMX_PROJECT project folder
CUBEMX_DTB_PATH_TFA     = "tf-a"
CUBEMX_DTB_PATH_TFA_SB  = "tf-a"
CUBEMX_DTB_PATH_UBOOT   = "u-boot"
CUBEMX_DTB_PATH_LINUX   = "kernel"
CUBEMX_DTB_PATH_OPTEEOS = "optee-os"

# Boot Mode Choice
# =========================================================================
# boot scheme (basic or trusted or optee)
# =========================================================================
BOOTSCHEME_LABELS = "trusted"

# Boot Device Choice
# =========================================================================
# flashlayout
# DISCO : sdcard
# EVAL : sdcard or emmc or nand-4-256 or nor-sdcard or nor-emmc or nor-nand-4-256
# =========================================================================
# Define the config labels to use to generate flashlayout file
BOOTDEVICE_LABELS += "sdcard"

# Support Feature Choice
# =========================================================================
# Define the features to enable on board
MACHINE_FEATURES += "bluetooth"
MACHINE_FEATURES += "wifi"

# Specific firmwares and kernel modules configuration
# =========================================================================
# Set the list of kernel module to be auto-loaded during boot
KERNEL_MODULE_AUTOLOAD += ""

# Set Bluetooth related package list needed when 'bluetooth' feature is enabled
#   NOTE    'linux-firmware-bluetooth-bcm4343' firmware is specific to BT/WIFI
#           combo used on DISCO boards"
BLUETOOTH_LIST += "linux-firmware-bluetooth-bcm4343"

# Set Wifi related package list needed when 'wifi' feature is enabled
#   NOTE    'linux-firmware-bcm43430' firmware is specific to BT/WIFI combo used
#           on DISCO boards
WIFI_LIST += "linux-firmware-bcm43430"

# Board Type Choice
# =========================================================================
CUBEMX_BOARD_REFERENCE = "stm32mp157c-dk2"
# Assign CubeMX Board DT and project name
CUBEMX_DTB = "stm32mp157c-demo-logic-analyser-mx"
CUBEMX_PROJECT = "mx/STM32MP157C-DK2/demo-logic-analyser/DeviceTree/demo-logic-analyser"
```
